## meta-evb-npcm750/conf/machine/evb-npcm750.conf
```bitbake
KMACHINE = "nuvoton"
KERNEL_DEVICETREE = "nuvoton-npcm750-evb.dtb"

UBOOT_MACHINE = "PolegSVB_config"

FLASH_SIZE = "32768"

IMAGE_INSTALL_append = "phosphor-ipmi-kcs"
# IMAGE_INSTALL_append = "iperf"

require conf/machine/include/npcm7xx.inc
require conf/machine/include/obmc-bsp-common.inc

# Inhibit phosphor-hwmon-config-mrw
VIRTUAL-RUNTIME_phosphor-hwmon-config = ""

# Inhibit phosphor-fan-presence-mrw-native
PREFERRED_PROVIDER_virtual/phosphor-fan-presence-config = \
    "phosphor-fan-presence-config-native"

# Inhibit phosphor-fan-control-fan-config-mrw-native
PREFERRED_PROVIDER_virtual/phosphor-fan-control-fan-config = \
    "phosphor-fan-control-fan-config-native"

PREFERRED_PROVIDER_virtual/phosphor-led-manager-config-native = "npcm750-led-manager-config-native"
```
